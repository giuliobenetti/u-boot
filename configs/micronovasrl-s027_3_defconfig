## configs/micronovasrl-s027_3_defconfig
```kconfig
CONFIG_ARM=y
CONFIG_SYS_VENDOR="micronovasrl"
CONFIG_SYS_BOARD="s027_3"
CONFIG_ARCH_SUNXI=y
CONFIG_SPL=y
CONFIG_IDENT_STRING=" Micronova srl S027_3"
CONFIG_MACH_SUN7I=y
CONFIG_DRAM_CLK=384
CONFIG_MMC0_CD_PIN="PH1"
CONFIG_USB0_VBUS_PIN="PH4"
CONFIG_USB1_VBUS_PIN="PH5"
CONFIG_USB2_VBUS_PIN="PH11"
# CONFIG_VIDEO_HDMI is not set
CONFIG_VIDEO_LCD_MODE="video"
CONFIG_VIDEO_LCD_POWER="PH0"
CONFIG_VIDEO_LCD_BL_PWM="PB2"
# CONFIG_VIDEO_LCD_BL_PWM_ACTIVE_LOW is not set
CONFIG_DEFAULT_DEVICE_TREE="sun7i-a20-s027_3"
# CONFIG_SYS_MALLOC_CLEAR_ON_INIT is not set
CONFIG_BOOTDELAY=1
# CONFIG_DISPLAY_CPUINFO is not set
# CONFIG_DISPLAY_BOARDINFO is not set
CONFIG_BOARD_EARLY_INIT_R=y
# CONFIG_BOARD_LATE_INIT is not set
CONFIG_SYS_MMCSD_RAW_MODE_U_BOOT_SECTOR=0x50
CONFIG_SYS_MMCSD_RAW_MODE_U_BOOT_DATA_PART_OFFSET=0x0
CONFIG_SPL_I2C_SUPPORT=y
CONFIG_CMD_BMP=y
# CONFIG_NETDEVICES is not set
CONFIG_AXP_ALDO3_VOLT=2800
CONFIG_AXP_ALDO4_VOLT=2800
CONFIG_USB_EHCI_HCD=y
# CONFIG_USB_GADGET is not set
CONFIG_SPLASH_SCREEN=y
CONFIG_SPLASHIMAGE_GUARD=y
CONFIG_SPLASH_SCREEN_ALIGN=y
CONFIG_SPLASH_SOURCE=y
```
